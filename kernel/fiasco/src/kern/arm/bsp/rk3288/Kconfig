## kernel/fiasco/src/kern/arm/bsp/rk3288/Kconfig
```kconfig
# PF: RK3288
# PFDESCR: Rockchip RK3288 Platform
# PFDEPENDS: ARM

choice
	prompt "RK3288 Platform"
	default PF_RK3288_EB

config PF_RK3288_EB
	bool "Emulation Baseboard (EB)"
	depends on PF_RK3288
	select CAN_ARM_CPU_CORTEX_A17
	help
	  Choose for Emulation Baseboard (EB)

config PF_RK3288_PB11MP
	bool "PB11MP"
	depends on PF_RK3288
	select CAN_ARM_CPU_MPCORE
	select CAN_ARM_CACHE_L2CXX0
	help
	  Choose for PB11MP

config PF_RK3288_PBX
	bool "PBX"
	depends on PF_RK3288
	select CAN_ARM_CPU_CORTEX_A9
	select CAN_ARM_CACHE_L2CXX0
	help
	  Choose for PBX-A9.

config PF_RK3288_VEXPRESS
	bool "Versatile Express"
	depends on PF_RK3288
	select CAN_ARM_CPU_CORTEX_A9
	select CAN_ARM_CPU_CORTEX_A15
	select CAN_ARM_CPU_CORTEX_A53
	select CAN_ARM_CPU_CORTEX_A57
	help
	  Choose for Versatile Express.

endchoice

config PF_RK3288_VEXPRESS_A9
	def_bool y
	depends on PF_RK3288_VEXPRESS && ARM_CORTEX_A9

config PF_RK3288_VEXPRESS_A15
	def_bool y
	depends on PF_RK3288_VEXPRESS && ARM_CORTEX_A15

config PF_RK3288_VEXPRESS_A53
	def_bool y
	depends on PF_RK3288_VEXPRESS && ARM_CORTEX_A53

config PF_RK3288_VEXPRESS_A57
	def_bool y
	depends on PF_RK3288_VEXPRESS && ARM_CORTEX_A57

choice
	prompt "Start of RAM (physical address)" if !PF_RK3288_EB
	default PF_RK3288_RAM_PHYS_BASE_0x6 if PF_RK3288_VEXPRESS_A9
	default PF_RK3288_RAM_PHYS_BASE_0x0

config PF_RK3288_RAM_PHYS_BASE_0x0
	bool "0x00000000"
	depends on !ARM_CORTEX_A15

config PF_RK3288_RAM_PHYS_BASE_0x2
	bool "0x20000000"
	depends on PF_RK3288_PBX

config PF_RK3288_RAM_PHYS_BASE_0x6
	bool "0x60000000"
	depends on PF_RK3288_VEXPRESS_A9

config PF_RK3288_RAM_PHYS_BASE_0x7
	bool "0x70000000"
	depends on PF_RK3288_PBX || PF_RK3288_PB11MP

config PF_RK3288_RAM_PHYS_BASE_0x8
	bool "0x80000000"
	depends on PF_RK3288_VEXPRESS_A15 || PF_RK3288_VEXPRESS_A53 || PF_RK3288_VEXPRESS_A57

endchoice

config PF_RK3288_RAM_PHYS_BASE
	hex
	default 0x0        if !PF_RK3288_RAM_PHYS_BASE_0x2 && !PF_RK3288_RAM_PHYS_BASE_0x6 && !PF_RK3288_RAM_PHYS_BASE_0x7 && !PF_RK3288_RAM_PHYS_BASE_0x8
	default 0x20000000 if PF_RK3288_RAM_PHYS_BASE_0x2
	default 0x60000000 if PF_RK3288_RAM_PHYS_BASE_0x6
	default 0x70000000 if PF_RK3288_RAM_PHYS_BASE_0x7
	default 0x80000000 if PF_RK3288_RAM_PHYS_BASE_0x8
```

## kernel/fiasco/src/kern/mips/Kconfig
```kconfig
# ARCH:           MIPS32 mips32
# ARCHDESCR:      MIPS32 processor family
#
# ARCHSELECT:     BIT32
# ARCHSELECT:     HAS_FPU_OPTION
# ARCHSELECT:     HAS_SERIAL_OPTION
# ARCHSELECT:     HAS_CPU_VIRT
#
# ARCHDEFAULTPF:  PF_MALTA

# SECTION: CPU

choice
	prompt "CPU"
	default CPU_MIPS32_R2

config CPU_MIPS32_R2
	bool "MIPS32 Release 2"
	depends on SYS_HAS_CPU_MIPS32_R2
	select CPU_MIPS32
	select CPU_MIPSR2
	help
	  Choose this if you have a MIPS32 Release 2 CPU.

config CPU_MIPS32_R6
	bool "MIPS32 Release 6"
	depends on SYS_HAS_CPU_MIPS32_R6
	select CPU_MIPS32
	select CPU_MIPSR6
	select WEAK_ORDERING
	select LIGHTWEIGHT_BARRIERS
	help
	  Choose this if you have a MIPS32 Release 6 CPU and toolchain.

endchoice

if MP
config WEAK_ORDERING
	bool
	prompt "Weakly ordered memory access" \
	  if HAS_WEAK_ORDERING_OPTION && !CPU_MIPSR6
	default y
	help
	  Choose this if you have a MIPS32 Release 2+ CPU with
	  weak memory ordering.
	  Say 'Y' if unsure.

config LIGHTWEIGHT_BARRIERS
	def_bool DEFAULT_LIGHTWEIGHT_BARRIERS
	prompt "Use lightweight barriers" \
	  if HAS_LIGHTWEIGHT_BARRIERS_OPTION && !CPU_MIPSR6 && WEAK_ORDERING
	help
	  Choose this option if your CPU supports lightweight sync instructions.
	  In particular sync 0x4, sync 0x10, sync 0x11, sync 0x12, sync 0x13 must
	  be supported.

endif

# SECTION: GLOBAL

config SYS_HAS_CPU_MIPS32_R2
	bool

config SYS_HAS_CPU_MIPS32_R6
	bool

config HAS_WEAK_ORDERING_OPTION
	bool

config HAS_LIGHTWEIGHT_BARRIERS_OPTION
	bool

config CPU_MIPS32
	bool

config CPU_MIPSR2
	bool

config CPU_MIPSR6
	bool

config CAN_MIPS_VZ_ASE
	bool

# SECTION: TARGET

config MIPS_CPU_FREQUENCY
	int "CPU frequency (MHz)"
	depends on MIPS32
	default 200
	help
	  Set the CPU frequency to match the platform's cpu frequency
	  for proper time keeping.

choice
        prompt "Minimum page size"
        default MIPS_PAGE_SIZE_16K

config MIPS_PAGE_SIZE_4K
        bool "4KB minimum page size"

config MIPS_PAGE_SIZE_16K
        bool "16KB minimum page size"

endchoice
```

## l4/mk/arch/Kconfig.mips.inc
```kconfig
# ARCH:       BUILD_ARCH_mips mips
# ARCHDESCR:  MIPS architecture
# ARCHSELECT: ARCH_ENABLE_STACK_PROTECTOR

config CPU
	string
	default "32r2"


choice
	prompt "Page Size"
	default PAGE_SIZE_16KB

config PAGE_SIZE_16KB
	bool "16KiB Page size"


config PAGE_SIZE_4KB
	bool "4KiB Page size"

endchoice
```
